#include <behaviors.dtsi>
#include <dt-bindings/zmk/keys.h>
#include <dt-bindings/zmk/bt.h>
#include <dt-bindings/zmk/outputs.h>
#include <dt-bindings/zmk/mouse.h>

/ {
    keymap {
        compatible = "zmk,keymap";

        default_layer {
            label = "move";
            bindings = <&bt BT_CLR &bt BT_SEL 0>;
            trackball-bindings = <&tmv>;
        };
    };
};
