## config/boards/shields/ball_only/Kconfig.defconfig
```kconfig
if SHIELD_BALL_ONLY

    config ZMK_KEYBOARD_NAME
        default "Ball_only"

endif
```

## config/boards/shields/charybdis_cirque/Kconfig.defconfig
```kconfig
if SHIELD_CHARYBDIS_CIRQUE_RIGHT

    config ZMK_KEYBOARD_NAME
        default "Charybdis_no"
    
    config ZMK_SPLIT_BLE_ROLE_CENTRAL
        default y

endif

if SHIELD_CHARYBDIS_CIRQUE_LEFT || SHIELD_CHARYBDIS_CIRQUE_RIGHT

    config ZMK_SPLIT
        default y

endif
```

## config/boards/shields/tracktyl/Kconfig.defconfig
```kconfig
if SHIELD_TRACKTYL_RIGHT

    config ZMK_SPLIT_BLE_ROLE_CENTRAL
        default y

endif

if SHIELD_TRACKTYL_LEFT || SHIELD_TRACKTYL_RIGHT

    config ZMK_KEYBOARD_NAME
        default "Charybdis_ball"

    config ZMK_SPLIT
        default y

endif
```

## config/west.yml
```yaml
manifest:
  remotes:
    - name: zmk
      url-base: https://github.com/ALpotato
  projects:
    - name: zmk
      remote: zmk
      revision: ptdevice-alpotato
      import: app/west.yml
  self:
    path: config
```
