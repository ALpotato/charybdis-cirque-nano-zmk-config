#include "charybdis_cirque.dtsi" // Notice that the main dtsi files are included in the overlay.

&default_transform {
    col-offset = <0>;
};

&kscan0 {
        col-gpios
            = <&pro_micro 16 GPIO_ACTIVE_HIGH> // col 0
            , <&pro_micro 14 GPIO_ACTIVE_HIGH> // col 1
            , <&pro_micro 15 GPIO_ACTIVE_HIGH> // col 2
            , <&pro_micro 18 GPIO_ACTIVE_HIGH> // col 3
            , <&pro_micro 19 GPIO_ACTIVE_HIGH> // col 4
            ;
};
