#include "charybdis_cirque.dtsi"

&default_transform { // The matrix transform for this board is 5 columns over because the left half is 5 columns wide according to the matrix.
    col-offset = <5>;
};

&kscan0 {
        col-gpios
            = <&pro_micro 16 (GPIO_ACTIVE_HIGH | GPIO_PULL_DOWN)>
            , <&pro_micro 14 (GPIO_ACTIVE_HIGH | GPIO_PULL_DOWN)>
            , <&pro_micro 15 (GPIO_ACTIVE_HIGH | GPIO_PULL_DOWN)>
            , <&pro_micro 18 (GPIO_ACTIVE_HIGH | GPIO_PULL_DOWN)>
            , <&pro_micro 19 (GPIO_ACTIVE_HIGH | GPIO_PULL_DOWN)>
            ;
};

&nice_nano_spi {
    status = "disabled";
};
&trackpad {
    status = "disabled";
};

/*
&pro_micro_spi {
    status = "disabled";

    miso-pin = <17>; // P0.17
    mosi-pin = <20>; // P0.20
    sck-pin = <22>; // P0.22
    cs-gpios = <&gpio0 24 GPIO_ACTIVE_LOW>; // P0.24

    trackball: trackball@0 {
        compatible = "pixart,pmw3360";
	status = "disabled";
        reg = <0>;
        label = "Pixart PMW3360";
        irq-gpios = <&gpio1 0 (GPIO_ACTIVE_LOW | GPIO_PULL_UP)>;
        spi-max-frequency = <2000000>;
        scroll-layer = <5>;
    };
};
*/
